## packages/dump1090/Config.in
```kconfig
config BR2_PACKAGE_DUMP1090
	bool "dump1090"
	depends on BR2_TOOLCHAIN_HAS_THREADS
	select BR2_PACKAGE_LIBAD9361_IIO
	select BR2_PACKAGE_LIBIIO
	help
	  Dump1090 is a simple Mode S decoder for PlutoSDR device

	  https://github.com/PlutoSDR/dump1090.git
comment "dump1090 needs a toolchain w/ threads"
        depends on !BR2_TOOLCHAIN_HAS_THREADS
```

## packages/soapysdr/Config.in
```kconfig
config BR2_PACKAGE_SOAPYSDR
	bool "soapysdr"
	help
	  Vendor and platform neutral SDR support library

	  https://github.com/pothosware/SoapySDR.git
```
